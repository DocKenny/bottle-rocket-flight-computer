## app/Kconfig
```kconfig
menu "Zephyr Kernel"
source "$ZEPHYR_BASE/Kconfig.zephyr"

config DATA_PROCESSING_THREAD_STACK_SIZE
    int "Data processing thread stack size"
    default 2048

config DATA_PROCESSING_THREAD_PRIORITY
    int "Data processing thread priority"
    default 5

config BLE_ADVERTISEMENT_TIME_SEC
    int "Bluetooth advertisement time in seconds"
    default 300

config FLIGHT_STATIONARY_WINDOW_MS
    int "Stationary detection window (ms)"
    default 3000
    help
      The continuous duration in milliseconds that the accelerometer
      magnitude must remain stable to trigger a landing event.

config FLIGHT_G_TARGET_X100
    int "Gravity target multiplied by 100"
    default 981
    help
      The target G magnitude (scaled by 100). E.g., 981 represents 9.81 m/s^2.

config FLIGHT_STATIONARY_TOLERANCE_X100
    int "Stationary tolerance multiplied by 100"
    default 40
    help
      The allowable variance above or below the G target (scaled by 100).
      E.g., 40 represents +/- 0.40 m/s^2 variance.

config FLIGHT_WAKEUP_THRESHOLD_UG
    int "Wake-up motion threshold (micro-Gs)"
    default 500000
    help
      The acceleration threshold in micro-Gs required to wake the sensor
      and trigger the flight state.
      1000000 uG = 1G.

endmenu
```

## app/sample.yaml
```yaml
sample:
  name: Main application firmware template example
common:
  sysbuild: true
  tags:
    - release
  platform_allow:
    - eartag@3.4.0

tests:
  app.prod:
    tags:
      - quick-build

  app.debug:
    extra_overlay_confs:
      - debug.conf
    extra_args:
      - FILE_SUFFIX=dev

  app.rtt:
    extra_overlay_confs:
      - debug.conf
      - rtt.conf
    extra_args:
      - FILE_SUFFIX=dev

  app.native_sim:
    platform_allow:
      - native_sim
    extra_overlay_confs:
      - debug.conf
      - uart.conf
    extra_args:
      - FILE_SUFFIX=dev
    extra_configs:
      # Native sim has a GPIO emulator, so we can enable GPIO to get a buildable app. We will not see the LED
      # blinking, but we will see the logs.
      - CONFIG_GPIO=y
```

## boards/vendor/eartag/Kconfig.defconfig
```kconfig
# Copyright (c) 2021 Nordic Semiconductor ASA
# SPDX-License-Identifier: Apache-2.0

if BOARD_EARTAG

config BOARD
    default "eartag"

endif # BOARD_EARTAG
```

## boards/vendor/eartag/Kconfig.eartag
```kconfig
config BOARD_EARTAG
	bool
	select SOC_FAMILY_NORDIC_NRF
	select SOC_NRF52811_QFAA
```

## boards/vendor/eartag/board.yml
```yaml
# Copyright (c) 2024 Nordic Semiconductor ASA
# SPDX-License-Identifier: Apache-2.0

board:
  name: eartag
  vendor: vendor
  revision:
    format: major.minor.patch
    default: 3.4.0
    exact: true
    revisions:
      - name: 3.4.0
  socs:
    - name: nrf52811
```

## boards/vendor/eartag/eartag_defconfig
```kconfig
# A Kconfig fragment that is merged as-is into the final build directory .config
# whenever an application is compiled for your board.

# Enable MPU
CONFIG_ARM_MPU=y

# Enable hardware stack protection
CONFIG_HW_STACK_PROTECTION=y

# enable GPIO
CONFIG_GPIO=y
CONFIG_PINCTRL=y
```
